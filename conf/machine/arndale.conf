## conf/machine/arndale.conf
```bitbake
#@TYPE: Machine
#@NAME: Arndale machine
#@DESCRIPTION: Machine configuration for the Anrdale board

require conf/machine/include/tune-cortexa15.inc
include conf/machine/include/arndale-default-settings.inc

KERNEL_IMAGETYPE = "uImage"
SDCARD_ROOTFS ?= "${DEPLOY_DIR_IMAGE}/${IMAGE_NAME}.rootfs.ext4"

UBOOT_ENTRYPOINT = "0x80008000"
UBOOT_LOADADDRESS = "0x80008000"

SPL_BINARY = "arndale-spl.bin"

KERNEL_DEVICETREE = "exynos5250-arndale.dtb"

EXTRA_IMAGEDEPENDS += "arndale-bootlets"

PREFERRED_PROVIDER_virtual/xserver = "xserver-xorg"
XSERVER = "xserver-xorg \
           xf86-input-evdev \
           xf86-video-modesetting \
           xf86-video-fbdev"

# Only has DVI connector for external screen
GUI_MACHINE_CLASS = "bigscreen"

PREFERRED_PROVIDER_virtual/kernel = "linux-exynos"
PREFERRED_PROVIDER_kernel-devicetree = "linux-exynos"

IMAGE_FSTYPES := " tar.xz sdcard ext4 "

# Guesswork
SERIAL_CONSOLE = "115200 ttySAC2"

UBOOT_MACHINE = "arndale_config"

# and sdio
MACHINE_FEATURES = "kernel26 screen apm usbgadget usbhost vfat alsa"

# the kernel image needs to be in /boot
MACHINE_ESSENTIAL_EXTRA_RDEPENDS = "kernel kernel-devicetree"

PREFERRED_PROVIDER_virtual/libgl = "mesa-gl"
PREFERRED_PROVIDER_virtual/mesa = "mesa-gl"
```
